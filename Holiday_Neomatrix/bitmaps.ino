// ===================== Snowflake 20x20 ======================

byte pict2[] = {
  0,9,45,82,105,0,10,45,82,105,1,9,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119
};

//
//
void Neomatrix_scroll_picture2(byte xoffset, byte pic_row, byte pic_col, int delayms) {

  ArduinoOTA.handle();
   
  byte x, y, red, green, blue;
  uint16_t mcolor1;

  int pixel_num = sizeof(pict2)/5;
  matrix.setBrightness(55);

  byte nscroll = 0;
  for (byte mm = 0 ; mm < pic_row + 9  ; mm++) {  // to scroll all the picture + 9
    matrix.fillScreen(0); 
     
    for (int nn = 0 ; nn < pixel_num ; nn++) {
      x = pict2[nn*5] + xoffset;
      y = pict2[nn*5+1] - nscroll + 8;
    
      if (y > -1 && y < 8) {
        red = pict2[nn*5+2];
        green = pict2[nn*5+3];
        blue = pict2[nn*5+4];

        mcolor1 = matrix.Color(red,green,blue);
        matrix.drawPixel(x, y, mcolor1); 
        //Serial.println(x);
        //delay(1);
      }
    }
    delay(delayms);
    //delay(100);
    matrix.show();
    nscroll = (nscroll + 1); // % (pic_row+4);
  }
}

// ========================== Vertical Scroll Down ==========================================

void Neomatrix_scroll_picture_down(byte xoffset, byte pic_row, byte pic_col, int delayms) {
  ArduinoOTA.handle();
  
  byte x, y, red, green, blue;
  uint16_t mcolor1;

  int pixel_num = sizeof(pict2)/5;
  matrix.setBrightness(55);

  byte nscroll = pic_row+8;
  for (byte mm = 0 ; mm < pic_row + 9  ; mm++) {  // to scroll all the picture + 9
    matrix.fillScreen(0); 
     
    for (int nn = 0 ; nn < pixel_num ; nn++) {
      x = pict2[nn*5] + xoffset;
      y = pict2[nn*5+1] - nscroll + 8;
    
      if (y > -1 && y < 8) {
        red = pict2[nn*5+2];
        green = pict2[nn*5+3];
        blue = pict2[nn*5+4];

        mcolor1 = matrix.Color(red,green,blue);
        matrix.drawPixel(x, y, mcolor1); 
        //Serial.println(x);
        //delay(1);
      }
    }
    delay(delayms);
    //delay(100);
    matrix.show();
    nscroll = (nscroll - 1);
  }
}

// ============================ Random Colors ==================================

void Neomatrix_scroll_picture_random_color(byte xoffset, byte pic_row, byte pic_col, int delayms) {

  int randn = random(0,767);
  byte x, y, red, green, blue;
  uint16_t mcolor1;

  int pixel_num = sizeof(pict2)/5;
  matrix.setBrightness(55);

  if (randn < 256) {
      red = 255 - randn;
      green = randn;
  } else if (randn < 511) {
      green = 511 - randn;
      blue = randn - 256;
  } else {
      red = 767 - randn;
      blue = randn - 512;
  }

  byte nscroll = 0;
  for (byte mm = 0 ; mm < pic_row + 9  ; mm++) {  // to scroll all the picture + 9
    matrix.fillScreen(0); 
     
    for (int nn = 0 ; nn < pixel_num ; nn++) {
      x = pict2[nn*5] + xoffset;
      y = pict2[nn*5+1] - nscroll + 8;
    
      if (y > -1 && y < 8) {
       // red = pict2[nn*5+2];
     //   green = pict2[nn*5+3];
      //  blue = pict2[nn*5+4];

        mcolor1 = matrix.Color(red,green,blue);
        matrix.drawPixel(x, y, mcolor1); 
        //Serial.println(x);
        //delay(1);
      }
    }
    delay(delayms);
    //delay(100);
    matrix.show();
    nscroll = (nscroll + 1); // % (pic_row+4);
  }
}
