// ===================== Turkey 35 x 32 ======================

byte pict2[] = {
0,14,239,118,125,1,12,239,116,123,1,13,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116
};

// ===================== Pacman ghost 12 x 11 ===============================================

byte pict1[] = {
0,1,4,5,17,0,2,4,6,61,0,3,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121
};

// ========================== Horizontal Scroll ========================================

void Neomatrix_horizontal_scroll_picture_random_color(byte xoffset, byte pic_row, byte pic_col, int delayms) {

  int randn = random(0,767);
  byte x, y, red, green, blue;
  int yupdown = -2;
  bool isyup   = true;
  uint16_t mcolor1;
  
  int pixel_num = sizeof(pict1)/5;
  matrix.setBrightness(55);

 // if (randn < 256) {
   //   red = 255 - randn;
//      green = randn;
 // } else if (randn < 511) {
 //     green = 511 - randn;
 //     blue = randn - 256;
 // } else {
  //    red = 767 - randn;
  //    blue = randn - 512;
 // }

  byte nscroll = 0;
  for (byte mm = 0 ; mm < NCOLUMNS ; mm++) {  // to scroll all the picture + 9
    matrix.fillScreen(0); 
    if (yupdown == 2) {
       isyup = false;
    } else if (yupdown == -2) {
       isyup = true;
    }
    if (isyup) {
      yupdown++;
    } else {
      yupdown--;
    }
     
    for (int nn = 0 ; nn < pixel_num ; nn++) {
      x = pict1[nn*5] + NCOLUMNS + xoffset - pic_col - mm;
      y = pict1[nn*5+1] + yupdown; // - nscroll + 8;
      Serial.print(x); Serial.print(","); Serial.println(y);
    
      if (y > -1 && y < 8) {
        red   = pict1[nn*5+4];
        green = pict1[nn*5+3];
        blue  = pict1[nn*5+2];

        mcolor1 = matrix.Color(red,green,blue);
        matrix.drawPixel(x, y, mcolor1); 
        //Serial.println(x);
        //delay(1);
      }
    }
    delay(delayms);
    matrix.show();
    nscroll = (nscroll + 1); // % (pic_row+4);
  }
}

// ========================== Vertical Scroll ==========================================

void Neomatrix_scroll_picture2(byte xoffset, byte pic_row, byte pic_col, int delayms) {
   
  byte x, y, red, green, blue;
  uint16_t mcolor1;

  int pixel_num = sizeof(pict2)/5;
  matrix.setBrightness(55);

  byte nscroll = 0;
  for (byte mm = 0 ; mm < pic_row + 9  ; mm++) {  // to scroll all the picture + 9
    matrix.fillScreen(0); 
     
    for (int nn = 0 ; nn < pixel_num ; nn++) {
      x = pict2[nn*5] + xoffset;
      y = pict2[nn*5+1] - nscroll + 8;
    
      if (y > -1 && y < 8) {
        red = pict2[nn*5+2];
        green = pict2[nn*5+3];
        blue = pict2[nn*5+4];

        mcolor1 = matrix.Color(red,green,blue);
        matrix.drawPixel(x, y, mcolor1); 
        //Serial.println(x);
        //delay(1);
      }
    }
    delay(delayms);
    //delay(100);
    matrix.show();
    nscroll = (nscroll + 1); // % (pic_row+4);
  }
}

// ============================ Random Colors ==================================

void Neomatrix_scroll_picture_random_color(byte xoffset, byte pic_row, byte pic_col, int delayms) {

  int randn = random(0,767);
  byte x, y, red, green, blue;
  uint16_t mcolor1;

  int pixel_num = sizeof(pict2)/5;
  matrix.setBrightness(55);

  if (randn < 256) {
      red = 255 - randn;
      green = randn;
  } else if (randn < 511) {
      green = 511 - randn;
      blue = randn - 256;
  } else {
      red = 767 - randn;
      blue = randn - 512;
  }

  byte nscroll = 0;
  for (byte mm = 0 ; mm < pic_row + 9  ; mm++) {  // to scroll all the picture + 9
    matrix.fillScreen(0); 
     
    for (int nn = 0 ; nn < pixel_num ; nn++) {
      x = pict2[nn*5] + xoffset;
      y = pict2[nn*5+1] - nscroll + 8;
    
      if (y > -1 && y < 8) {
       // red = pict2[nn*5+2];
     //   green = pict2[nn*5+3];
      //  blue = pict2[nn*5+4];

        mcolor1 = matrix.Color(red,green,blue);
        matrix.drawPixel(x, y, mcolor1); 
        //Serial.println(x);
        //delay(1);
      }
    }
    delay(delayms);
    //delay(100);
    matrix.show();
    nscroll = (nscroll + 1); // % (pic_row+4);
  }
}
